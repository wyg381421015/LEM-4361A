#include <rtthread.h>
#include <rtdevice.h>
#include <global.h>
#include <screen.h>
#include <board.h>
#include <meter.h>

const unsigned char gImage_logo[8000] = { /* 0X10,0X10,0X00,0X64,0X00,0X28,0X01,0X1B, */
0XFF,0XFF,0XFF,0XFF,0XFF,0XFF,0XFF,0XFF,0XFF,0XFF,0XFF,0XFF,0XFF,0XFF,0XFF,0XFF,
0XFF,0XFF,0XFF,0XFF,0XFF,0XFF,0XFF,0XFF,0XFF,0XFF,0XFF,0XFF,0XFF,0XFF,0XFF,0XFF,
0XFF,0XFF,0XFF,0XFF,0XFF,0XFF,0XFF,0XFF,0XFF,0XFF,0XFF,0XFF,0XFF,0XFF,0XFF,0XFF,
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0XFF,0XFF,0XFF,0XFF,0XFF,0XFF,0XFF,0XFF,0XFF,0XFF,0XFF,0XFF,0XFF,0XFF,0XFF,0XFF,
};




const unsigned char gImage_battery[2000] = { /* 0X10,0X10,0X00,0X28,0X00,0X19,0X01,0X1B, */
0XFF,0XFF,0XC6,0X38,0X10,0XC3,0X10,0XC3,0X10,0XC3,0X10,0XC3,0X10,0XC3,0X10,0XC3,
0X10,0XC3,0X10,0XC3,0X10,0XC3,0X10,0XC3,0X10,0XC3,0X10,0XC3,0X10,0XC3,0X10,0XC3,
0X10,0XC3,0X10,0XC3,0X10,0XC3,0X10,0XC3,0X10,0XC3,0X10,0XC3,0X10,0XC3,0X10,0XC3,
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0X08,0X61,0X08,0X61,0X08,0X61,0X08,0X61,0X08,0X61,0XFF,0XFF,0XFF,0XFF,0XFF,0XFF,
};


const unsigned char gImage_signal[1500] = { /* 0X10,0X10,0X00,0X1E,0X00,0X19,0X01,0X1B, */
0XFF,0XFF,0XFF,0XFF,0XFF,0XFF,0XFF,0XFF,0XFF,0XFF,0XFF,0XFF,0XFF,0XFF,0XFF,0XFF,
0XFF,0XFF,0XFF,0XFF,0XFF,0XFF,0XFF,0XFF,0XFF,0XFF,0XFF,0XFF,0XFF,0XFF,0XFF,0XFF,
0XFF,0XFF,0XFF,0XFF,0XFF,0XFF,0XFF,0XFF,0XFF,0XFF,0XFF,0XFF,0XFF,0XFF,0XFF,0XFF,
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0XFF,0XFF,0XFF,0XFF,0XFF,0XFF,0XFF,0XFF,0XFF,0XFF,0XFF,0XFF,};


const unsigned char gImage_wifi[1250] = { /* 0X10,0X10,0X00,0X19,0X00,0X19,0X01,0X1B, */
0XFF,0XFF,0XFF,0XFF,0XFF,0XFF,0XFF,0XFF,0XFF,0XFF,0XFF,0XFF,0XFF,0XFF,0XFF,0XFF,
0XFF,0XFF,0XFF,0XFF,0XFF,0XFF,0XFF,0XFF,0XFF,0XFF,0XFF,0XFF,0XFF,0XFF,0XFF,0XFF,
0XFF,0XFF,0XFF,0XFF,0XFF,0XFF,0XFF,0XFF,0XFF,0XFF,0XFF,0XFF,0XFF,0XFF,0XFF,0XFF,
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0XFF,0XFF,};


const unsigned char gImage_phone[750] = { /* 0X10,0X10,0X00,0X0F,0X00,0X19,0X01,0X1B, */
0XFF,0XFF,0XFF,0XFF,0XFF,0XFF,0XFF,0XFF,0XFF,0XFF,0XFF,0XFF,0XFF,0XFF,0XFF,0XFF,
0XFF,0XFF,0XFF,0XFF,0XFF,0XFF,0XFF,0XFF,0XFF,0XFF,0XFF,0XFF,0XFF,0XFF,0XFF,0XFF,
0XFF,0XFF,0XFF,0XFF,0XFF,0XFF,0XFF,0X7E,0XFF,0XBE,0XFE,0XFB,0XFF,0XFF,0XFF,0XFF,
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0XFF,0XFF,0XFF,0XFF,0XFF,0XFF,0XFF,0XFF,0XFF,0XFF,0XFF,0XFF,0XFF,0XFF,};


const unsigned char gImage_secret[1250] = { /* 0X10,0X10,0X00,0X19,0X00,0X19,0X01,0X1B, */
0XFF,0XFF,0XFF,0XFF,0XFF,0XFF,0XFF,0XFF,0XFF,0XFF,0XFF,0XFF,0XFF,0XFF,0XFF,0XFF,
0XFF,0XFF,0XFF,0XFF,0XFF,0XFF,0XFF,0XFF,0XFF,0XFF,0XFF,0XFF,0XFF,0XFF,0XFF,0XFF,
0XFF,0XFF,0XFF,0XFF,0XFF,0XFF,0XFF,0XFF,0XFF,0XFF,0XFF,0XFF,0XFF,0XFF,0XFF,0XFF,
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0XFF,0XFF,};


const unsigned char gImage_bluetooth[750] = { /* 0X10,0X10,0X00,0X0F,0X00,0X19,0X01,0X1B, */
0XFF,0XFF,0XFF,0XFF,0XFF,0XFF,0XFF,0XFF,0XFF,0XFF,0XFF,0XFF,0XFF,0XFF,0XFF,0XFF,
0XFF,0XFF,0XFF,0XFF,0XFF,0XFF,0XFF,0XFF,0XFF,0XFF,0XFF,0XFF,0XFF,0XFF,0XFF,0XFF,
0XFF,0XFF,0XFF,0XFF,0XFF,0XFF,0XFF,0XFF,0XFF,0XFF,0XFF,0XFF,0X07,0XFF,0XFF,0XFF,
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0XFF,0XFF,0XFF,0XFF,0XFF,0XFF,0XFF,0XFF,0XFF,0XFF,0XFF,0XFF,0XFF,0XFF,};


const unsigned char gImage_alarm[1250] = { /* 0X10,0X10,0X00,0X19,0X00,0X19,0X01,0X1B, */
0XFF,0XFF,0XFF,0XFF,0XFF,0XFF,0XFF,0XFF,0XFF,0XFF,0XFF,0XFF,0XFF,0XFF,0XFF,0XFF,
0XFF,0XFF,0XC6,0X18,0X84,0X10,0XF8,0X00,0XF8,0X00,0XF8,0X00,0XC6,0X18,0XC6,0X18,
0XFF,0XFF,0XFF,0XFF,0XFF,0XFF,0XFF,0XFF,0XFF,0XFF,0XFF,0XFF,0XFF,0XFF,0XFF,0XFF,
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0XFF,0XFF,};


#define DEVICE_NAME			"lcd"//串口5设备名

#define THREAD_SCREEN_PRIORITY     14
#define THREAD_SCREEN_STACK_SIZE   1024
#define THREAD_SCREEN_TIMESLICE    5


#define KEY_PIN				GET_PIN(F,10)
#define TOUCH_PIN			GET_PIN(A,1)


static rt_uint8_t screen_stack[THREAD_SCREEN_STACK_SIZE];//线程堆栈

static struct rt_thread screen;
static rt_device_t lcddev;

static rt_uint8_t s_ucLCD_ScrNum = SCR_001;//当前界面号
static rt_uint8_t s_ucLCD__PasPageNum = 0xff;//过去界面号

static rt_uint8_t s_ucLCD_BKtime = 0;//屏幕背光延时时间
static rt_uint8_t s_ucLCD_BKstate = 0;//屏幕背光状态  1 关闭  0打开
static rt_uint8_t s_ucLCD_tp = 0;//确认有触摸动作
static rt_uint8_t s_ucLCD_TPfinish= 0;//读取是否完成

static rt_uint8_t s_ucLCD_tpx,s_ucLCD_tpy;//触摸位置

static char s_cStrBuf[20];//屏幕显示字符缓存

static STR_SYSTEM_TIME stSystem_PasTime;//判断是否要刷新的时间

static ScmMeter_Analog stMeter_Analog;//电度表计量数据
//static ScmMeter_HisData stMeter_HisData;//meter历史数据缓存结构体

void key_callback(void *args);//按键回调函数
void touch_callback(void *args);//触摸回调函数


static void screen_thread_entry(void *parameter)//lcd显示任务
{
	rt_err_t ret = RT_EOK;
	rt_uint16_t i;
	rt_uint32_t temp;

	lcddev = (rt_device_t)rt_device_find(DEVICE_NAME);//查找设备
	
	if(lcddev != RT_NULL)//是否找到设备
	{
		rt_lprintf("[Screen]:lcddev device find sucess!\r\n");
		
		if (rt_device_open(lcddev, 0) == RT_EOK)//打开设备成功
		{
			rt_lprintf("[Screen]:Open lcddev device sucess!\r\n");
		}
	}
	else
	{
		rt_lprintf("[Screen]:Not find device lcddev!\r\n");
		return;
	}
	
	rt_pin_mode(KEY_PIN, PIN_MODE_INPUT_PULLUP);//按键中断引脚
//	rt_pin_mode(TOUCH_PIN, PIN_MODE_INPUT_PULLUP);//触摸中断引脚
	rt_pin_attach_irq(KEY_PIN,PIN_IRQ_MODE_RISING,key_callback,(void*)"lcd backlight on");//绑定中断回调函数
//	rt_pin_attach_irq(TOUCH_PIN,PIN_IRQ_MODE_FALLING,touch_callback,(void*)"lcd backlight on");//绑定中断回调函数
	rt_pin_irq_enable(KEY_PIN,PIN_IRQ_ENABLE);//开启gpio中断使能
//	rt_pin_irq_enable(TOUCH_PIN,PIN_IRQ_ENABLE);//开启gpio中断使能
	
	memset(&stSystem_PasTime.Second,0,sizeof(STR_SYSTEM_TIME));
	
	LCD_DisPlayScreen000();
	
	rt_thread_mdelay(100);
	

	while (1)
	{
//		cmMeter_get_data(EMMETER_HISDATA,&stMeter_HisData.ulMeter_Total);//获取电表计量数据
				
		LCD_UpdateScreen();//刷新界面
		
		if(	s_ucLCD_ScrNum != s_ucLCD__PasPageNum)//显示界面
			LCD_DisPlayScreen();
		
		s_ucLCD_BKtime++;
		if((s_ucLCD_BKtime>30)&&(s_ucLCD_BKstate != 1))//30秒关闭屏幕背光 界面返回首界面
		{
			s_ucLCD_BKtime = 30;
			s_ucLCD_BKstate = 1;
			s_ucLCD_ScrNum = SCR_001;
			lcddev->control(lcddev,RTGRAPHIC_CTRL_BACKOFF,0);
			rt_lprintf("[Screen]:lcd backlight off!\r\n");
		}
		if(s_ucLCD_TPfinish == 1)//超间隔后 使能触摸中断
		{
			s_ucLCD_TPfinish = 0;
			rt_pin_irq_enable(TOUCH_PIN,PIN_IRQ_ENABLE);
		}
		rt_thread_mdelay(500);
	}
}


void key_callback(void *args)//按键回调函数
{
	char *a = args;

	lcddev->control(lcddev,RTGRAPHIC_CTRL_BACKON,0);
	rt_lprintf("[Screen]:key down %s!\r\n",a);
	if(s_ucLCD_BKstate != 1)
	{
		s_ucLCD_ScrNum++;
		if(s_ucLCD_ScrNum>4)
		{
			s_ucLCD_ScrNum = SCR_001;
		}
	}
	s_ucLCD_BKtime = 0;
	s_ucLCD_BKstate = 0;
}

void touch_callback(void *args)//按键回调函数
{
	char *a = args;
	rt_uint32_t temp;
	rt_uint16_t x,y,last_x,last_y;
	
	rt_pin_irq_enable(TOUCH_PIN,PIN_IRQ_DISABLE);//关闭gpio外部中断
	
	lcddev->control(lcddev,RTGRAPHIC_CTRL_BACKON,0);

	rt_lprintf("[Screen]:touch lcd %s!\r\n",a);
	
	
	if(s_ucLCD_BKstate != 1)
	{
		s_ucLCD_ScrNum++;
		if(s_ucLCD_ScrNum>4)
		{
			s_ucLCD_ScrNum = SCR_001;
		}
	}
	s_ucLCD_BKtime = 0;
	s_ucLCD_BKstate = 0;
	
	last_x = 16;
	last_y = 16;

	s_ucLCD_tp = 0;
	s_ucLCD_TPfinish = 0;
//	while(s_ucLCD_TPfinish == 0)
//	{
//		if(rt_pin_read(TOUCH_PIN) == PIN_LOW)
//		{
//			temp = lmt028_get_touch_location();
//			x = temp>>16;
//			y = temp&0xffff;
//			s_ucLCD_tp = 1;
//		}
//		
//		if((last_x == x)&&(last_y == y))
//		{
//			s_ucLCD_TPfinish = 1;
//		}
//		rt_thread_mdelay(10);
//		if(s_ucLCD_tp)
//		{
//			last_x =x;
//			last_y =y;
//		}	
//	}
//	s_ucLCD_tpx = x;
//	s_ucLCD_tpy = y;
	
	
	if(rt_pin_read(TOUCH_PIN) == PIN_LOW)
	{
		temp = lmt028_get_touch_location();
		x = temp>>16;
		y = temp&0xffff;
		s_ucLCD_tp = 1;
	}
	s_ucLCD_tpx = x;
	s_ucLCD_tpy = y;
	s_ucLCD_TPfinish = 1;
	
	
//	rt_pin_irq_enable(TOUCH_PIN,PIN_IRQ_ENABLE);

	rt_lprintf("[Screen]:touch lcd_x = %d lcd_y = %d!\r\n",s_ucLCD_tpx,s_ucLCD_tpy);

}


static void LCD_DisPlayScreen(void)
{
	switch(s_ucLCD_ScrNum)
	{
		case SCR_000:
			LCD_DisPlayScreen000();
			break;
		case SCR_001:
			LCD_DisPlayScreen001();
			break;
		case SCR_002:
			LCD_DisPlayScreen002();
			break;
		case SCR_003:
			LCD_DisPlayScreen003();
			break;
		case SCR_004:
			LCD_DisPlayScreen004();
			break;
		default:
			break;
	}
}

static void LCD_UpdateScreen(void)
{

	switch(s_ucLCD_ScrNum)
	{
		case SCR_000:
			break;
		case SCR_001:
			LCD_UpdateScreen001();
			break;
		case SCR_002:
			LCD_UpdateScreen002();
			break;
		case SCR_003:
			LCD_UpdateScreen003();
			break;
		case SCR_004:
			LCD_UpdateScreen004();
			break;
		default:
			break;
	}
	LCD_UpdateTime();
}

static void LCD_DisPlayScreen000(void)
{
//	s_ucLCD_ScrNum = SCR_000;
//	s_ucLCD__PasPageNum = SCR_000;
	
	rt_graphix_ops(lcddev)->set_bmp(5,5,(void*)gImage_signal,30,25);
	rt_graphix_ops(lcddev)->set_bmp(35,5,(void*)gImage_wifi,25,25);
	rt_graphix_ops(lcddev)->set_bmp(60,5,(void*)gImage_phone,15,25);
	rt_graphix_ops(lcddev)->set_bmp(75,5,(void*)gImage_secret,25,25);		
	rt_graphix_ops(lcddev)->set_bmp(100,5,(void*)gImage_alarm,25,25);
	
	rt_graphix_ops(lcddev)->set_bmp(255,5,(void*)gImage_bluetooth,15,25);
	rt_graphix_ops(lcddev)->set_bmp(275,5,(void*)gImage_battery,40,25);
	
	rt_graphix_ops(lcddev)->draw_hline(CYAN,1,319,35);
	rt_graphix_ops(lcddev)->draw_hline(CYAN,1,319,200);

	rt_graphix_ops(lcddev)->draw_hline(CYAN,0,319,1);
	rt_graphix_ops(lcddev)->draw_hline(CYAN,0,319,2);
	
	rt_graphix_ops(lcddev)->draw_hline(CYAN,0,319,237);
	rt_graphix_ops(lcddev)->draw_hline(CYAN,0,319,238);
	
	rt_graphix_ops(lcddev)->draw_vline(CYAN,1,1,239);
	rt_graphix_ops(lcddev)->draw_vline(CYAN,2,1,239);
	
	rt_graphix_ops(lcddev)->draw_vline(CYAN,317,1,239);
	rt_graphix_ops(lcddev)->draw_vline(CYAN,318,1,239);
	
}

static void LCD_DisPlayScreen001(void)
{
	rt_graphix_ops(lcddev)->fill_fb(WHITE,10,310,40,200);
	
	rt_graphix_ops(lcddev)->draw_circle(GREEN,85,130,65);
	rt_graphix_ops(lcddev)->draw_circle(GREEN,85,130,64);
	rt_graphix_ops(lcddev)->draw_circle(GREEN,85,130,63);
	
	rt_graphix_ops(lcddev)->draw_hline(RED,35,135,160);

	rt_graphix_ops(lcddev)->set_font24(61,100,(void*)"正常",BLUE,WHITE);
	
	rt_graphix_ops(lcddev)->set_bmp(170,70,(void*)gImage_logo,100,40);
	rt_graphix_ops(lcddev)->set_font24(170,130,(void*)"欢迎使用",BLUE,WHITE);
	rt_graphix_ops(lcddev)->set_font24(170,160,(void*)"智慧终端",BLUE,WHITE);
	
	s_ucLCD_ScrNum = SCR_001;
	s_ucLCD__PasPageNum = SCR_001;
	
}
static void LCD_DisPlayScreen002(void)
{
	rt_uint8_t i,month;
	
	s_ucLCD_ScrNum = SCR_002;
	s_ucLCD__PasPageNum = SCR_002;
	
	BCD_toInt(&month,&System_Time_STR.Month,1);
	
//	cmMeter_get_data(EMMETER_HISDATA,&stMeter_HisData.ulMeter_Total);//获取电表计量数据
	
	rt_graphix_ops(lcddev)->fill_fb(WHITE,10,310,40,200);
	
	rt_graphix_ops(lcddev)->set_font24(10,60,(void*)"上1月尖总电量:        KWH",BLUE,WHITE);
	rt_graphix_ops(lcddev)->set_font24(10,90,(void*)"上1月峰总电量:        KWH",BLUE,WHITE);
	rt_graphix_ops(lcddev)->set_font24(10,120,(void*)"上1月平总电量:        KWH",BLUE,WHITE);
	rt_graphix_ops(lcddev)->set_font24(10,150,(void*)"上1月谷总电量:        KWH",BLUE,WHITE);
	
	if(System_Time_STR.Month == 0x01)
	{
//		rt_graphix_ops(lcddev)->set_font24(180,60,(void*)LCD_Ltoa(s_cStrBuf,stMeter_HisData.ulMeter_Month[11].ulPowerJ,8,3),BLUE,WHITE);
//		rt_graphix_ops(lcddev)->set_font24(180,90,(void*)LCD_Ltoa(s_cStrBuf,stMeter_HisData.ulMeter_Month[11].ulPowerF,8,3),BLUE,WHITE);
//		rt_graphix_ops(lcddev)->set_font24(180,120,(void*)LCD_Ltoa(s_cStrBuf,stMeter_HisData.ulMeter_Month[11].ulPowerP,8,3),BLUE,WHITE);
//		rt_graphix_ops(lcddev)->set_font24(180,150,(void*)LCD_Ltoa(s_cStrBuf,stMeter_HisData.ulMeter_Month[11].ulPowerG,8,3),BLUE,WHITE);
	}
	else
	{
//		rt_graphix_ops(lcddev)->set_font24(180,60,(void*)LCD_Ltoa(s_cStrBuf,stMeter_HisData.ulMeter_Month[month-2].ulPowerJ,8,3),BLUE,WHITE);
//		rt_graphix_ops(lcddev)->set_font24(180,90,(void*)LCD_Ltoa(s_cStrBuf,stMeter_HisData.ulMeter_Month[month-2].ulPowerF,8,3),BLUE,WHITE);
//		rt_graphix_ops(lcddev)->set_font24(180,120,(void*)LCD_Ltoa(s_cStrBuf,stMeter_HisData.ulMeter_Month[month-2].ulPowerP,8,3),BLUE,WHITE);
//		rt_graphix_ops(lcddev)->set_font24(180,150,(void*)LCD_Ltoa(s_cStrBuf,stMeter_HisData.ulMeter_Month[month-2].ulPowerG,8,3),BLUE,WHITE);
	}
}
static void LCD_DisPlayScreen003(void)
{
	rt_uint8_t i,month;
	
	s_ucLCD_ScrNum = SCR_003;
	s_ucLCD__PasPageNum = SCR_003;
	
	BCD_toInt(&month,&System_Time_STR.Month,1);
	
	rt_graphix_ops(lcddev)->fill_fb(WHITE,10,310,40,200);
	
	rt_graphix_ops(lcddev)->set_font24(10,60,(void*)"上2月尖总电量:        KWH",BLUE,WHITE);
	rt_graphix_ops(lcddev)->set_font24(10,90,(void*)"上2月峰总电量:        KWH",BLUE,WHITE);
	rt_graphix_ops(lcddev)->set_font24(10,120,(void*)"上2月平总电量:        KWH",BLUE,WHITE);
	rt_graphix_ops(lcddev)->set_font24(10,150,(void*)"上2月谷总电量:        KWH",BLUE,WHITE);
	
//	if(System_Time_STR.Month == 0x01)
//	{
//		rt_graphix_ops(lcddev)->set_font24(180,60,(void*)LCD_Ltoa(s_cStrBuf,stMeter_HisData.ulMeter_Month[10].ulPowerJ,8,3),BLUE,WHITE);
//		rt_graphix_ops(lcddev)->set_font24(180,90,(void*)LCD_Ltoa(s_cStrBuf,stMeter_HisData.ulMeter_Month[10].ulPowerF,8,3),BLUE,WHITE);
//		rt_graphix_ops(lcddev)->set_font24(180,120,(void*)LCD_Ltoa(s_cStrBuf,stMeter_HisData.ulMeter_Month[10].ulPowerP,8,3),BLUE,WHITE);
//		rt_graphix_ops(lcddev)->set_font24(180,150,(void*)LCD_Ltoa(s_cStrBuf,stMeter_HisData.ulMeter_Month[10].ulPowerG,8,3),BLUE,WHITE);
//	}
//	else if(System_Time_STR.Month == 0x02)
//	{
//		rt_graphix_ops(lcddev)->set_font24(180,60,(void*)LCD_Ltoa(s_cStrBuf,stMeter_HisData.ulMeter_Month[11].ulPowerJ,8,3),BLUE,WHITE);
//		rt_graphix_ops(lcddev)->set_font24(180,90,(void*)LCD_Ltoa(s_cStrBuf,stMeter_HisData.ulMeter_Month[11].ulPowerF,8,3),BLUE,WHITE);
//		rt_graphix_ops(lcddev)->set_font24(180,120,(void*)LCD_Ltoa(s_cStrBuf,stMeter_HisData.ulMeter_Month[11].ulPowerP,8,3),BLUE,WHITE);
//		rt_graphix_ops(lcddev)->set_font24(180,150,(void*)LCD_Ltoa(s_cStrBuf,stMeter_HisData.ulMeter_Month[11].ulPowerG,8,3),BLUE,WHITE);
//	}
//	else
//	{
//		rt_graphix_ops(lcddev)->set_font24(180,60,(void*)LCD_Ltoa(s_cStrBuf,stMeter_HisData.ulMeter_Month[month-3].ulPowerJ,8,3),BLUE,WHITE);
//		rt_graphix_ops(lcddev)->set_font24(180,90,(void*)LCD_Ltoa(s_cStrBuf,stMeter_HisData.ulMeter_Month[month-3].ulPowerF,8,3),BLUE,WHITE);
//		rt_graphix_ops(lcddev)->set_font24(180,120,(void*)LCD_Ltoa(s_cStrBuf,stMeter_HisData.ulMeter_Month[month-3].ulPowerP,8,3),BLUE,WHITE);
//		rt_graphix_ops(lcddev)->set_font24(180,150,(void*)LCD_Ltoa(s_cStrBuf,stMeter_HisData.ulMeter_Month[month-3].ulPowerG,8,3),BLUE,WHITE);
//	}
}
static void LCD_DisPlayScreen004(void)
{
	s_ucLCD_ScrNum = SCR_004;
	s_ucLCD__PasPageNum = SCR_004;
	
	memset(s_cStrBuf,0,20);
	
	rt_graphix_ops(lcddev)->fill_fb(WHITE,10,310,40,200);
	
	cmMeter_get_data(EMMETER_ANALOG,&stMeter_Analog.ulVol);//获取电表计量数据
	
	rt_graphix_ops(lcddev)->set_font24(10,60,(void*)"总电量  :          KWH",BLUE,WHITE);
	rt_graphix_ops(lcddev)->set_font24(10,90,(void*)"交流电压:          V",BLUE,WHITE);
	rt_graphix_ops(lcddev)->set_font24(10,120,(void*)"交流电流:          A",BLUE,WHITE);
	rt_graphix_ops(lcddev)->set_font24(10,150,(void*)"功率因数:",BLUE,WHITE);
	
	rt_graphix_ops(lcddev)->set_font24(120,60,(void*)LCD_Ltoa(s_cStrBuf,stMeter_Analog.ulMeterTotal,8,3),BLUE,WHITE);
	rt_graphix_ops(lcddev)->set_font24(120,90,(void*)LCD_Ltoa(s_cStrBuf,stMeter_Analog.ulVol*10,6,2),BLUE,WHITE);
	rt_graphix_ops(lcddev)->set_font24(120,120,(void*)LCD_Ltoa(s_cStrBuf,stMeter_Analog.ulCur,6,2),BLUE,WHITE);
	rt_graphix_ops(lcddev)->set_font24(120,150,(void*)LCD_Ltoa(s_cStrBuf,stMeter_Analog.ulPwrFactor,5,3),BLUE,WHITE);
	
}

static void LCD_UpdateScreen001(void)
{
	rt_uint8_t i;
	
	if(s_ucLCD__PasPageNum == SCR_001)
	{
		for(i=0;i<50;i++)
		{
			rt_graphix_ops(lcddev)->draw_hline(RED,35,45+i,160);
			
			rt_graphix_ops(lcddev)->draw_line(WHITE,45+i,160,55+i,140);
			rt_graphix_ops(lcddev)->draw_line(WHITE,55+i,140,65+i,180);
			rt_graphix_ops(lcddev)->draw_line(WHITE,65+i,180,75+i,160);
			
			rt_graphix_ops(lcddev)->draw_hline(WHITE,45+i,75+i,160);
			
			rt_graphix_ops(lcddev)->draw_line(RED,45+i+1,160,55+i+1,140);
			rt_graphix_ops(lcddev)->draw_line(RED,55+i+1,140,65+i+1,180);
			rt_graphix_ops(lcddev)->draw_line(RED,65+i+1,180,75+i+1,160);
			rt_graphix_ops(lcddev)->draw_hline(WHITE,45+i+1,75+i+1,160);
			rt_graphix_ops(lcddev)->draw_hline(RED,76+i,86+i,160);
			
			rt_thread_mdelay(20);
			
			if(i == 49)
			{
				rt_graphix_ops(lcddev)->draw_line(WHITE,45+i+1,160,55+i+1,140);
				rt_graphix_ops(lcddev)->draw_line(WHITE,55+i+1,140,65+i+1,180);
				rt_graphix_ops(lcddev)->draw_line(WHITE,65+i+1,180,75+i+1,160);
				rt_graphix_ops(lcddev)->draw_hline(RED,76,86+i,160);
			}
		}
	}
}
static void LCD_UpdateScreen002(void)
{

}
	
static void LCD_UpdateScreen003(void)
{
	
}
	
static void LCD_UpdateScreen004(void)
{
	cmMeter_get_data(EMMETER_ANALOG,&stMeter_Analog.ulVol);//获取电表计量数据
	
	rt_graphix_ops(lcddev)->set_font24(120,60,(void*)LCD_Ltoa(s_cStrBuf,stMeter_Analog.ulMeterTotal,8,3),BLUE,WHITE);
	rt_graphix_ops(lcddev)->set_font24(120,90,(void*)LCD_Ltoa(s_cStrBuf,stMeter_Analog.ulVol*10,6,2),BLUE,WHITE);
	rt_graphix_ops(lcddev)->set_font24(120,120,(void*)LCD_Ltoa(s_cStrBuf,stMeter_Analog.ulCur,6,2),BLUE,WHITE);
	rt_graphix_ops(lcddev)->set_font24(120,150,(void*)LCD_Ltoa(s_cStrBuf,stMeter_Analog.ulPwrFactor,5,3),BLUE,WHITE);
}
	
static void LCD_UpdateTime(void)
{
	rt_uint8_t i,year,month,day,hour,minute,second;
	
	memset(s_cStrBuf,0,20);
	
	if(stSystem_PasTime.Year != System_Time_STR.Year)
	{
		stSystem_PasTime.Year = System_Time_STR.Year;
		BCD_toInt(&year,&System_Time_STR.Year,1);
		rt_graphix_ops(lcddev)->set_font24(85,215,(void*)"20  -  -     :  :  ",BLUE,WHITE);
		rt_graphix_ops(lcddev)->set_font24(109,215,(void*)LCD_Ltoa(s_cStrBuf,year,2,0),BLUE,WHITE);
	}
	if(stSystem_PasTime.Month != System_Time_STR.Month)
	{
		stSystem_PasTime.Month = System_Time_STR.Month;
		BCD_toInt(&month,&System_Time_STR.Month,1);
		rt_graphix_ops(lcddev)->set_font24(145,215,(void*)LCD_Ltoa(s_cStrBuf,month,2,0),BLUE,WHITE);
	}
	if(stSystem_PasTime.Day != System_Time_STR.Day)
	{
		stSystem_PasTime.Day = System_Time_STR.Day;
		BCD_toInt(&day,&System_Time_STR.Day,1);
		rt_graphix_ops(lcddev)->set_font24(181,215,(void*)LCD_Ltoa(s_cStrBuf,day,2,0),BLUE,WHITE);
	}
	if(stSystem_PasTime.Hour != System_Time_STR.Hour)
	{
		stSystem_PasTime.Hour = System_Time_STR.Hour;
		BCD_toInt(&hour,&System_Time_STR.Hour,1);
		rt_graphix_ops(lcddev)->set_font24(217,215,(void*)LCD_Ltoa(s_cStrBuf,hour,2,0),BLUE,WHITE);
	}
	if(stSystem_PasTime.Minute != System_Time_STR.Minute)
	{
		stSystem_PasTime.Minute = System_Time_STR.Minute;
		BCD_toInt(&minute,&System_Time_STR.Minute,1);
		rt_graphix_ops(lcddev)->set_font24(253,215,(void*)LCD_Ltoa(s_cStrBuf,minute,2,0),BLUE,WHITE);
	}
	if(stSystem_PasTime.Second != System_Time_STR.Second)
	{
		stSystem_PasTime.Second = System_Time_STR.Second;
		BCD_toInt(&second,&System_Time_STR.Second,1);
		rt_graphix_ops(lcddev)->set_font24(289,215,(void*)LCD_Ltoa(s_cStrBuf,second,2,0),BLUE,WHITE);
	}
}

//无符号long 转带小数点的字符串
static char* LCD_Ltoa(char *buf, unsigned long i, int len, char dec)
{
	char  *s;
	unsigned long  rem;
	unsigned long  tmp;
	char  index = 0;

	tmp = i;
	buf[len] = 0;
	s = &buf[len];                

	while( len-- )
	{
		if( dec != 0 )            
		{
			index++;               
			if(index == dec + 1)    
			{
				*--s = '.';
			}
			else                    
			{
				rem = tmp % 10;
				*--s = rem + '0';  
				tmp /= 10;
			}
		}
		else
		{
			rem = tmp % 10;
			*--s = rem + '0';
			tmp /= 10;
		}
	}

	return(buf);
}


int screen_thread_init(void)
{
	rt_err_t res;
	
	res=rt_thread_init(&screen,
											"screen",
											screen_thread_entry,
											RT_NULL,
											screen_stack,
											THREAD_SCREEN_STACK_SIZE,
											THREAD_SCREEN_PRIORITY,
											THREAD_SCREEN_TIMESLICE);
	if (res == RT_EOK) 
	{
			rt_thread_startup(&screen);
	}
	return res;
}


#if defined (RT_SCREEN_AUTORUN) && defined(RT_USING_COMPONENTS_INIT)
	INIT_APP_EXPORT(screen_thread_init);
#endif
MSH_CMD_EXPORT(screen_thread_init, screen thread run);


